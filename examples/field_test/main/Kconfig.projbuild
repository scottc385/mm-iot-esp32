## examples/router_sta/main/Kconfig.projbuild
```kconfig
menu "HaLow router STA"

    config ROUTER_STA_UDP_LOCAL_PORT
        int "UDP/TBX local port"
        default 5000

    config ROUTER_STA_UDP_PEER_IP
        string "UDP/TBX peer IP"
        default "192.168.50.1"

    config ROUTER_STA_UDP_PEER_PORT
        int "UDP/TBX peer port"
        default 5000

    config ROUTER_STA_STATUS_INTERVAL_MS
        int "Status/heartbeat interval in milliseconds"
        default 5000

    config ROUTER_STA_LOOP_DELAY_MS
        int "Router main loop delay in milliseconds"
        default 50
        help
            Delay between router-service poll passes. Keep low for latency
            sensitive field transports such as MS/TP; the MS/TP profile uses
            5 ms to avoid adding router-loop latency to ReadProperty traffic.

    choice ROUTER_STA_HALOW_CHANNEL_PRESET
        prompt "HaLow channel preset"
        default ROUTER_STA_HALOW_CHANNEL_1MHZ_LOW
        help
            Narrow the STA scan/connect channel list for demo and benchmark
            builds. The AP must be configured to the same channel/bandwidth.

        config ROUTER_STA_HALOW_CHANNEL_1MHZ_LOW
            bool "1 MHz low: channel 13, 908.5 MHz"

        config ROUTER_STA_HALOW_CHANNEL_1MHZ_MID
            bool "1 MHz mid: channel 25, 914.5 MHz"

        config ROUTER_STA_HALOW_CHANNEL_1MHZ_HIGH
            bool "1 MHz high: channel 41, 922.5 MHz"

        config ROUTER_STA_HALOW_CHANNEL_2MHZ_MID
            bool "2 MHz mid: channel 26, 915.0 MHz"

        config ROUTER_STA_HALOW_CHANNEL_2MHZ_HIGH
            bool "2 MHz high: channel 42, 923.0 MHz"

        config ROUTER_STA_HALOW_CHANNEL_4MHZ_LOW
            bool "4 MHz low: channel 24, 914.0 MHz"

        config ROUTER_STA_HALOW_CHANNEL_4MHZ_MID
            bool "4 MHz mid: channel 32, 918.0 MHz"

        config ROUTER_STA_HALOW_CHANNEL_4MHZ_HIGH
            bool "4 MHz high: channel 40, 922.0 MHz"

        config ROUTER_STA_HALOW_CHANNEL_8MHZ_HIGH
            bool "8 MHz high: channel 44, 924.0 MHz"
    endchoice

    config ROUTER_STA_CLI_ENABLE
        bool "Enable ESP-IDF console router CLI"
        default y
        help
            Starts the ESP-IDF console REPL and registers router-* commands
            backed by NVS. Settings apply on the next reboot.

    config ROUTER_STA_HALOW_IPV6_ENABLE
        bool "Enable HaLow IPv6 autoconfiguration"
        default n
        help
            Enable IPv6 autoconfiguration on the Morse HaLow netif. Disabled
            by default for the router MVP because the router uses IPv4 UDP/TBX
            and BACnet/IP, and ESP-IDF/LwIP IPv6 ND6/MLDv6 timer handling has
            caused repeat boot crashes during prototype testing.

    config ROUTER_STA_TBX_ORIGIN_ID
        string "Router STA TBX origin ID"
        default "ESP1"
        help
            Four-byte origin ID included in TBX frames. Longer strings are
            truncated; shorter strings are zero padded.

    config ROUTER_STA_UDP_TBX_NET
        int "UDP/TBX transit network number"
        default 65000

    config ROUTER_STA_UDP_TBX_PORT_ID
        int "UDP/TBX router port ID"
        default 1

    config ROUTER_STA_UDP_TBX_LOG_FRAMES
        bool "Log each UDP/TBX routed frame"
        default y
        help
            Disable for latency tests. Status counters and error/drop logs
            remain enabled.

    config ROUTER_STA_NET_BLOCK
        int "Router BACnet network block"
        range 1 6
        default 1
        help
            MVP site/deployment block used for auto-derived local BACnet
            networks. Auto-derived network numbers use:
            net_block * 10000 + node_id * 10 + transport_slot.

    config ROUTER_STA_NODE_ID
        int "Router node ID"
        range 1 999
        default 1
        help
            Operator-assigned short numeric node ID. This is used for
            auto-derived MVP BACnet network numbers and may also be used by
            provisioning scripts as the HaLow static IP last octet.

    config ROUTER_STA_LOCAL_APP_ENABLE
        bool "Enable in-process local BACnet test app"
        default y
        help
            Registers a minimal local BACnet application port behind the ESP32
            router. The current implementation responds to routed Who-Is with
            I-Am, and is used to validate Pi -> ESP routed application traffic
            before W5500 BACnet/IP and RS485 MS/TP transports are added.

    config ROUTER_STA_LOCAL_APP_PORT_ID
        int "Local app router port ID"
        default 2

    config ROUTER_STA_LOCAL_APP_NET
        int "Local app BACnet network number"
        default 5001

    config ROUTER_STA_LOCAL_APP_DEVICE_ID
        int "Local app BACnet device instance"
        default 500100

    config ROUTER_STA_LOCAL_APP_OBJECT_NAME
        string "Local app BACnet object name"
        default "esp32-local-app"

    config ROUTER_STA_DNET_TTL_MS
        int "Router learned DNET TTL in milliseconds"
        default 60000

    config ROUTER_STA_LOG_LEVEL
        int "Router service log level"
        default 1

    config ROUTER_STA_SEGMENT_DIAG_LOG
        bool "Temporary segmented BACnet routing diagnostics"
        default y
        help
            Temporary verbose diagnostics for segmented BACnet response
            debugging. Logs B/IP and UDP/TBX lengths, sendto return values,
            APDU type/invoke/segment flags, and MTU warnings without changing
            routing behavior.

    config ROUTER_STA_DEBUG_APP_PROBE_DNET
        int "Debug routed application probe DNET"
        default 0
        help
            If non-zero, periodically send a routed BACnet Who-Is application
            NPDU using this DNET as the BACnet destination address after the
            UDP/TBX port has learned a matching peer route. This verifies
            learned-route application traffic before additional local
            transports are added.

    config ROUTER_STA_DEBUG_ROUTE_PROBE_DNET
        int "Deprecated debug route probe DNET"
        default 0
        help
            Deprecated compatibility alias for older sdkconfig files. Prefer
            ROUTER_STA_DEBUG_APP_PROBE_DNET.

    config ROUTER_STA_W5500_PROBE_ENABLE
        bool "Enable W5500 Ethernet hardware probe"
        default n
        select ETH_USE_SPI_ETHERNET
        help
            Starts a W5500 Ethernet interface after the HaLow router path is
            configured. This is a hardware bring-up probe only; it logs link
            and DHCP state but does not yet register BACnet/IP as a router
            transport.

    config ROUTER_STA_W5500_BIP_ENABLE
        bool "Enable W5500 BACnet/IP router transport"
        default n
        select ROUTER_STA_W5500_PROBE_ENABLE
        help
            Opens a BACnet/IP UDP socket on the W5500 Ethernet side and
            registers it as a router service port. This is the first field-side
            Ethernet transport for the ESP32 HaLow router MVP.

    config ROUTER_STA_W5500_IPV6_LINKLOCAL_ENABLE
        bool "Enable W5500 IPv6 link-local address"
        default n
        depends on ROUTER_STA_W5500_PROBE_ENABLE
        help
            Create an IPv6 link-local address on the W5500 Ethernet netif.
            Disabled by default because the router uses IPv4 BACnet/IP and
            ESP-IDF/LwIP IPv6 multicast state has caused boot-time crashes on
            the W5500 path during prototype bring-up.

    config ROUTER_STA_W5500_BIP_PORT_ID
        int "W5500 BACnet/IP router port ID"
        default 3

    config ROUTER_STA_W5500_BIP_LOG_FRAMES
        bool "Log each W5500 BACnet/IP routed frame"
        default y
        depends on ROUTER_STA_W5500_BIP_ENABLE
        help
            Disable for latency tests. Status counters and error/drop logs
            remain enabled.

    config ROUTER_STA_W5500_BIP_NET_AUTO
        bool "Auto-derive W5500 BACnet/IP network number"
        default y
        help
            Derive transport.bip.0's BACnet network number from the MVP scheme:
            net_block * 10000 + node_id * 10 + transport_slot. W5500 B/IP uses
            transport_slot 0. Disable this to use the explicit configured
            W5500 BACnet/IP network number below.

    config ROUTER_STA_W5500_BIP_NET
        int "W5500 BACnet/IP network number"
        default 10010
        help
            Explicit W5500 BACnet/IP network number used when
            ROUTER_STA_W5500_BIP_NET_AUTO is disabled. Do not use low lab
            numbers such as 2001 by default; they can conflict with real
            BACnet networks.

    config ROUTER_STA_W5500_BIP_UDP_PORT
        int "W5500 BACnet/IP UDP port"
        default 47808

    config ROUTER_STA_W5500_BIP_BROADCAST_ADDR
        string "W5500 BACnet/IP broadcast address"
        default "255.255.255.255"
        help
            IPv4 broadcast target for BACnet/IP Original-Broadcast-NPDU
            frames on the W5500 side. On dual-interface ESP32 builds, prefer
            the W5500 subnet broadcast address instead of 255.255.255.255 so
            lwIP does not have to choose between HaLow and Ethernet netifs.

    config ROUTER_STA_W5500_WIR_INTERVAL_MS
        int "W5500 Who-Is-Router refresh interval in milliseconds"
        default 30000
        depends on ROUTER_STA_W5500_BIP_ENABLE
        help
            Broadcast Who-Is-Router-To-Network on the W5500 BACnet/IP side at
            startup and then at this slow interval. This lets the ESP rebuild
            routes behind field-side B/IP routers after an ESP restart, even if
            BACnet tools keep running and do not resend discovery. Set 0 to
            disable the W5500-side refresh probe.

    config ROUTER_STA_W5500_POLL_PERIOD_MS
        int "W5500 driver poll period in milliseconds"
        default 10
        depends on ROUTER_STA_W5500_PROBE_ENABLE
        help
            Used only when the W5500 interrupt GPIO is disabled. Lower values
            reduce receive latency at the cost of more SPI polling.

    config ROUTER_STA_W5500_SPI_HOST
        int "W5500 SPI host"
        default 2

    config ROUTER_STA_W5500_SPI_MISO_GPIO
        int "W5500 SPI MISO GPIO"
        default 38

    config ROUTER_STA_W5500_SPI_MOSI_GPIO
        int "W5500 SPI MOSI GPIO"
        default 45

    config ROUTER_STA_W5500_SPI_SCLK_GPIO
        int "W5500 SPI SCLK GPIO"
        default 21

    config ROUTER_STA_W5500_SPI_CS_GPIO
        int "W5500 SPI CS GPIO"
        default 41

    config ROUTER_STA_W5500_INT_GPIO
        int "W5500 INT GPIO"
        default 39

    config ROUTER_STA_W5500_RST_GPIO
        int "W5500 reset GPIO"
        default 40

    config ROUTER_STA_W5500_SPI_CLOCK_MHZ
        int "W5500 SPI clock in MHz"
        default 10

    config ROUTER_STA_W5500_PHY_ADDR
        int "W5500 PHY address"
        default 1

    config ROUTER_STA_W5500_MAC_TASK_STACK_SIZE
        int "W5500 MAC RX task stack size"
        default 4096

    config ROUTER_STA_W5500_WAIT_IP_TIMEOUT_MS
        int "W5500 DHCP wait timeout in milliseconds"
        default 8000

    config ROUTER_STA_W5500_STATIC_IP_ENABLE
        bool "Use static IPv4 address for W5500"
        default n
        help
            Disable DHCP on the W5500 Ethernet interface and apply the
            compile-time IPv4 settings below. Use this for isolated BACnet/IP
            field networks that do not provide DHCP.

    config ROUTER_STA_W5500_STATIC_IP_ADDR
        string "W5500 static IPv4 address"
        default "192.168.92.253"
        depends on ROUTER_STA_W5500_STATIC_IP_ENABLE

    config ROUTER_STA_W5500_STATIC_NETMASK
        string "W5500 static IPv4 netmask"
        default "255.255.255.0"
        depends on ROUTER_STA_W5500_STATIC_IP_ENABLE

    config ROUTER_STA_W5500_STATIC_GATEWAY
        string "W5500 static IPv4 gateway"
        default "192.168.92.1"
        depends on ROUTER_STA_W5500_STATIC_IP_ENABLE

    config ROUTER_STA_RS485_PROBE_ENABLE
        bool "Enable isolated RS485/MS-TP hardware probe"
        default n
        help
            Initializes the Proto-2 RS485 UART and transceiver control pins
            without registering MS/TP as a router port. Use this first to
            validate TX, RX, DE, and /RE wiring before adding BACnet MS/TP.

    config ROUTER_STA_RS485_UART_NUM
        int "RS485 UART number"
        default 1
        depends on ROUTER_STA_RS485_PROBE_ENABLE

    config ROUTER_STA_RS485_TX_GPIO
        int "RS485 TX GPIO"
        default 10
        depends on ROUTER_STA_RS485_PROBE_ENABLE

    config ROUTER_STA_RS485_RX_GPIO
        int "RS485 RX GPIO"
        default 11
        depends on ROUTER_STA_RS485_PROBE_ENABLE

    config ROUTER_STA_RS485_DE_GPIO
        int "RS485 driver-enable GPIO"
        default 12
        depends on ROUTER_STA_RS485_PROBE_ENABLE

    config ROUTER_STA_RS485_RE_N_GPIO
        int "RS485 receiver-enable active-low GPIO"
        default 13
        depends on ROUTER_STA_RS485_PROBE_ENABLE
        help
            Set to -1 if DE and /RE are tied together externally. Proto-2 uses
            separate DE and /RE pins.

    config ROUTER_STA_RS485_BAUD
        int "RS485 probe baud rate"
        default 38400
        depends on ROUTER_STA_RS485_PROBE_ENABLE

    config ROUTER_STA_RS485_PROBE_INTERVAL_MS
        int "RS485 probe transmit interval in milliseconds"
        default 0
        depends on ROUTER_STA_RS485_PROBE_ENABLE
        help
            Sends a short diagnostic byte sequence at this interval with DE
            asserted. Set 0 for receive-only probe mode.

    config ROUTER_STA_RS485_PROBE_LOG_FRAMES
        bool "Log every parsed RS485/MS-TP probe frame"
        default n
        depends on ROUTER_STA_RS485_PROBE_ENABLE
        help
            Enable verbose per-frame probe logging. Leave disabled for normal
            bring-up so UART console logging does not perturb the MS/TP bus.

    config ROUTER_STA_RS485_PROBE_SUMMARY_INTERVAL_MS
        int "RS485/MS-TP probe summary interval in milliseconds"
        default 5000
        depends on ROUTER_STA_RS485_PROBE_ENABLE
        help
            Emit aggregate passive probe counters at this interval. Set 0 to
            disable summaries.

    config ROUTER_STA_MSTP_ENABLE
        bool "Enable BACnet MS/TP router transport"
        default n
        help
            Opens the Proto-2 RS485 UART as a BACnet MS/TP master and
            registers it as transport.mstp.0 in the router service. This is a
            real field-side BACnet transport, not the passive RS485 probe.

    config ROUTER_STA_MSTP_PORT_ID
        int "MS/TP router port ID"
        default 4
        depends on ROUTER_STA_MSTP_ENABLE

    config ROUTER_STA_MSTP_NET_AUTO
        bool "Auto-derive MS/TP BACnet network number"
        default y
        depends on ROUTER_STA_MSTP_ENABLE
        help
            Derive transport.mstp.0's BACnet network number from the MVP
            scheme: net_block * 10000 + node_id * 10 + transport_slot. MS/TP
            #1 uses transport_slot 1.

    config ROUTER_STA_MSTP_NET
        int "MS/TP BACnet network number"
        default 10011
        depends on ROUTER_STA_MSTP_ENABLE
        help
            Explicit MS/TP network number used when ROUTER_STA_MSTP_NET_AUTO
            is disabled.

    config ROUTER_STA_MSTP_MAC
        int "MS/TP MAC address"
        range 0 127
        default 3
        depends on ROUTER_STA_MSTP_ENABLE
        help
            MAC address used by the ESP32 on the local MS/TP bus. Proto-2
            bring-up observed existing masters at low addresses, so this must
            remain configurable.

    config ROUTER_STA_MSTP_MAX_MASTER
        int "MS/TP Max_Master"
        range 1 127
        default 127
        depends on ROUTER_STA_MSTP_ENABLE

    config ROUTER_STA_MSTP_MAX_INFO_FRAMES
        int "MS/TP Max_Info_Frames"
        range 1 16
        default 1
        depends on ROUTER_STA_MSTP_ENABLE

    config ROUTER_STA_MSTP_UART_NUM
        int "MS/TP UART number"
        default 1
        depends on ROUTER_STA_MSTP_ENABLE

    config ROUTER_STA_MSTP_TX_GPIO
        int "MS/TP UART TX GPIO"
        default 10
        depends on ROUTER_STA_MSTP_ENABLE

    config ROUTER_STA_MSTP_RX_GPIO
        int "MS/TP UART RX GPIO"
        default 11
        depends on ROUTER_STA_MSTP_ENABLE

    config ROUTER_STA_MSTP_DE_GPIO
        int "MS/TP RS485 driver-enable GPIO"
        default 12
        depends on ROUTER_STA_MSTP_ENABLE

    config ROUTER_STA_MSTP_RE_N_GPIO
        int "MS/TP RS485 receiver-enable active-low GPIO"
        default 13
        depends on ROUTER_STA_MSTP_ENABLE
        help
            Set to -1 if receiver enable is tied externally. Proto-2 uses a
            separate active-low /RE pin.

    config ROUTER_STA_MSTP_BAUD
        int "MS/TP baud rate"
        default 38400
        depends on ROUTER_STA_MSTP_ENABLE

    config ROUTER_STA_MSTP_RX_STREAM_SIZE
        int "MS/TP UART RX stream buffer size"
        default 4096
        depends on ROUTER_STA_MSTP_ENABLE

    config ROUTER_STA_MSTP_PDU_QUEUE_LEN
        int "MS/TP complete NPDU receive queue length"
        range 4 64
        default 16
        depends on ROUTER_STA_MSTP_ENABLE
        help
            Number of complete MS/TP NPDUs that can be queued between the
            MS/TP FSM task and the router loop. Increase this for bursty
            Who-Is/I-Am discovery traffic.

    config ROUTER_STA_MSTP_DRAIN_MAX
        int "MS/TP NPDUs drained per router pass"
        range 1 64
        default 8
        depends on ROUTER_STA_MSTP_ENABLE
        help
            Maximum queued MS/TP NPDUs drained into the router service per
            main-loop pass. Higher values prevent burst backlogs.

    config ROUTER_STA_MSTP_LOG_FRAMES
        bool "Log each routed MS/TP frame"
        default n
        depends on ROUTER_STA_MSTP_ENABLE
        help
            Keep disabled during timing tests. Status counters remain enabled;
            frame-level logs can perturb MS/TP timing during bursts.

    config ROUTER_STA_MSTP_FSM_TASK_STACK_SIZE
        int "MS/TP FSM task stack size"
        default 4096
        depends on ROUTER_STA_MSTP_ENABLE

    config ROUTER_STA_MSTP_UART_TASK_STACK_SIZE
        int "MS/TP UART task stack size"
        default 3072
        depends on ROUTER_STA_MSTP_ENABLE

endmenu
```
