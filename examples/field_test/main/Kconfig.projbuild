## examples/router_sta/sdkconfig.defaults.esp32s3.heltec_ht_hc01p
```kconfig
#
# ESP32-S3 + Heltec HT-HC01P carrier router STA profile.
#
CONFIG_ESP32S3_INSTRUCTION_CACHE_32KB=y
CONFIG_MM_BCF_FILE="bcf_mf08551.mbin"
CONFIG_MM_FW_FILE="mm6108.mbin"
CONFIG_MM_RESET_N=1
CONFIG_MM_WAKE=2
CONFIG_MM_BUSY=5
CONFIG_MM_SPI_SCK=7
CONFIG_MM_SPI_MOSI=9
CONFIG_MM_SPI_MISO=8
CONFIG_MM_SPI_CS=4
CONFIG_MM_SPI_IRQ=3

CONFIG_ROUTER_STA_UDP_LOCAL_PORT=5000
CONFIG_ROUTER_STA_UDP_PEER_IP="192.168.50.1"
CONFIG_ROUTER_STA_UDP_PEER_PORT=5000
CONFIG_ROUTER_STA_STATUS_INTERVAL_MS=5000
CONFIG_ROUTER_STA_DEBUG_APP_PROBE_DNET=0
# CONFIG_ROUTER_STA_LOCAL_APP_ENABLE is not set
CONFIG_ROUTER_STA_LOCAL_APP_PORT_ID=2
CONFIG_ROUTER_STA_LOCAL_APP_NET=5001
CONFIG_ROUTER_STA_LOCAL_APP_DEVICE_ID=500100
CONFIG_ROUTER_STA_LOCAL_APP_OBJECT_NAME="esp32-local-app"
```

## examples/router_sta/sdkconfig.defaults.esp32s3.heltec_ht_hc01p.w5500_probe
```kconfig
CONFIG_ROUTER_STA_W5500_PROBE_ENABLE=y
CONFIG_ROUTER_STA_W5500_BIP_ENABLE=y
CONFIG_ROUTER_STA_NET_BLOCK=5
CONFIG_ROUTER_STA_NODE_ID=2
CONFIG_ROUTER_STA_W5500_BIP_PORT_ID=3
CONFIG_ROUTER_STA_W5500_BIP_NET_AUTO=y
CONFIG_ROUTER_STA_W5500_BIP_NET=50020
CONFIG_ROUTER_STA_W5500_BIP_UDP_PORT=47808
CONFIG_ROUTER_STA_W5500_BIP_BROADCAST_ADDR="192.168.92.255"
CONFIG_ROUTER_STA_W5500_SPI_HOST=2
CONFIG_ROUTER_STA_W5500_SPI_MISO_GPIO=38
CONFIG_ROUTER_STA_W5500_SPI_MOSI_GPIO=45
CONFIG_ROUTER_STA_W5500_SPI_SCLK_GPIO=21
CONFIG_ROUTER_STA_W5500_SPI_CS_GPIO=41
CONFIG_ROUTER_STA_W5500_INT_GPIO=-1
CONFIG_ROUTER_STA_W5500_RST_GPIO=40
CONFIG_ROUTER_STA_W5500_SPI_CLOCK_MHZ=10
CONFIG_ROUTER_STA_W5500_PHY_ADDR=1
CONFIG_ROUTER_STA_W5500_MAC_TASK_STACK_SIZE=4096
CONFIG_ROUTER_STA_W5500_WAIT_IP_TIMEOUT_MS=8000
CONFIG_ROUTER_STA_W5500_STATIC_IP_ENABLE=y
CONFIG_ROUTER_STA_W5500_STATIC_IP_ADDR="192.168.92.253"
CONFIG_ROUTER_STA_W5500_STATIC_NETMASK="255.255.255.0"
CONFIG_ROUTER_STA_W5500_STATIC_GATEWAY="192.168.92.1"
CONFIG_ESP_MAIN_TASK_STACK_SIZE=8192
```

## examples/sta_connect/sdkconfig.defaults
```kconfig
CONFIG_FREERTOS_HZ=1000

CONFIG_IDF_TARGET="esp32s3"

CONFIG_MBEDTLS_NIST_KW_C=y
CONFIG_MM_BCF_FILE="bcf_fgh100mhaamd.mbin"
CONFIG_MM_RESET_N=1
CONFIG_MM_WAKE=2
CONFIG_MM_BUSY=5
CONFIG_MM_SPI_SCK=7
CONFIG_MM_SPI_MOSI=9
CONFIG_MM_SPI_MISO=8
CONFIG_MM_SPI_CS=4
CONFIG_MM_SPI_IRQ=3
```

## examples/sta_reboot/sdkconfig.defaults
```kconfig
CONFIG_FREERTOS_HZ=1000

CONFIG_IDF_TARGET="esp32s3"

CONFIG_MBEDTLS_NIST_KW_C=y
CONFIG_MM_RESET_N=3
CONFIG_MM_WAKE=8
CONFIG_MM_BUSY=9
CONFIG_MM_SPI_SCK=12
CONFIG_MM_SPI_MOSI=11
CONFIG_MM_SPI_MISO=13
CONFIG_MM_SPI_CS=10
CONFIG_MM_SPI_IRQ=14
```

## examples/transfer_reset/sdkconfig.defaults.esp32s3
```kconfig
#
# ESP32S3-specific
#
CONFIG_ESP32S3_INSTRUCTION_CACHE_32KB=y
CONFIG_MM_RESET_N=3
CONFIG_MM_WAKE=8
CONFIG_MM_BUSY=9
CONFIG_MM_SPI_SCK=12
CONFIG_MM_SPI_MOSI=11
CONFIG_MM_SPI_MISO=13
CONFIG_MM_SPI_CS=10
CONFIG_MM_SPI_IRQ=14
```
