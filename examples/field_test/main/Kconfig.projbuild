## examples/field_test/main/Kconfig.projbuild
```kconfig
menu "HaLow field test"

    config FIELD_BUTTON_GPIO
        int "Field-test button GPIO"
        default 0
        help
            GPIO used for manual field-test trigger. ESP32 boot button is usually GPIO0.

    config FIELD_BUTTON_ACTIVE_LOW
        bool "Button is active low"
        default y

    config FIELD_RGB_PWM_ENABLE
        bool "Enable PWM RGB status LED"
        default n
        help
            Enable this only if the board RGB LED exposes separate red/green/blue GPIOs.
            Some ESP32-S3 boards use a single addressable RGB LED instead; that needs a
            different driver and should leave this disabled.

    config FIELD_RGB_ADDR_ENABLE
        bool "Enable addressable RGB status LED"
        default y
        help
            Enable this for boards with a single WS2812/SK6812-style addressable RGB LED.
            The Hosyond ESP32-S3 N16R8 board appears to use GPIO48.

    config FIELD_RGB_ADDR_GPIO
        int "Addressable RGB LED GPIO"
        default 48
        depends on FIELD_RGB_ADDR_ENABLE

    config FIELD_RGB_RED_GPIO
        int "PWM RGB red GPIO"
        default -1
        depends on FIELD_RGB_PWM_ENABLE

    config FIELD_RGB_GREEN_GPIO
        int "PWM RGB green GPIO"
        default -1
        depends on FIELD_RGB_PWM_ENABLE

    config FIELD_RGB_BLUE_GPIO
        int "PWM RGB blue GPIO"
        default -1
        depends on FIELD_RGB_PWM_ENABLE

    config FIELD_RGB_ACTIVE_LOW
        bool "PWM RGB channels are active low"
        default n
        depends on FIELD_RGB_PWM_ENABLE

    config FIELD_TRIGGER_AP_IP
        string "AP control IP for button trigger packets"
        default "192.168.50.1"

    config FIELD_TRIGGER_PORT
        int "AP control UDP port for button trigger packets"
        default 5010

    config FIELD_OUT_OF_RANGE_RSSI_DBM
        int "RSSI threshold considered marginal/out-of-range"
        default -88

    config FIELD_STATUS_INTERVAL_MS
        int "Serial status interval in milliseconds"
        default 5000

endmenu
```

## examples/field_test/sdkconfig.defaults
```kconfig
CONFIG_LWIP_NETIF_STATUS_CALLBACK=y
CONFIG_LWIP_NETIF_LINK_CALLBACK=y
CONFIG_LWIP_IPV6_AUTOCONFIG=y
CONFIG_LWIP_IPV6_DHCP6=y

CONFIG_FREERTOS_HZ=1000

CONFIG_IDF_TARGET="esp32s3"

CONFIG_LWIP_IRAM_OPTIMIZATION=y
CONFIG_LWIP_TCP_MSS=1460
CONFIG_LWIP_TCP_SND_BUF_DEFAULT=8760
CONFIG_LWIP_TCP_WND_DEFAULT=14600
CONFIG_LWIP_TCP_RECVMBOX_SIZE=10
CONFIG_LWIP_UDP_RECVMBOX_SIZE=10

CONFIG_PARTITION_TABLE_SINGLE_APP_LARGE=y

CONFIG_MBEDTLS_NIST_KW_C=y
CONFIG_MM_RESET_N=1
CONFIG_MM_WAKE=2
CONFIG_MM_BUSY=5
CONFIG_MM_SPI_SCK=7
CONFIG_MM_SPI_MOSI=9
CONFIG_MM_SPI_MISO=8
CONFIG_MM_SPI_CS=4
CONFIG_MM_SPI_IRQ=3
```

## examples/field_test/sdkconfig.defaults.esp32s3.heltec_ht_hc01p_noled
```kconfig
#
# ESP32-S3 + Heltec HT-HC01P carrier field-test profile with LED output disabled.
#
CONFIG_ESP32S3_INSTRUCTION_CACHE_32KB=y
CONFIG_MM_BCF_FILE="bcf_mf08551.mbin"
CONFIG_MM_FW_FILE="mm6108.mbin"
CONFIG_MM_RESET_N=1
CONFIG_MM_WAKE=2
CONFIG_MM_BUSY=5
CONFIG_MM_SPI_SCK=7
CONFIG_MM_SPI_MOSI=9
CONFIG_MM_SPI_MISO=8
CONFIG_MM_SPI_CS=4
CONFIG_MM_SPI_IRQ=3

CONFIG_FIELD_BUTTON_GPIO=0
CONFIG_FIELD_BUTTON_ACTIVE_LOW=y

CONFIG_FIELD_RGB_PWM_ENABLE=n
CONFIG_FIELD_RGB_ADDR_ENABLE=n
CONFIG_FIELD_RGB_ADDR_GPIO=48
CONFIG_FIELD_TRIGGER_AP_IP="192.168.50.1"
CONFIG_FIELD_TRIGGER_PORT=5010
CONFIG_FIELD_OUT_OF_RANGE_RSSI_DBM=-88
CONFIG_FIELD_STATUS_INTERVAL_MS=5000
```

## examples/iperf/sdkconfig.defaults.esp32s3
```kconfig
#
# ESP32S3-specific
#
CONFIG_ESP32S3_INSTRUCTION_CACHE_32KB=y
CONFIG_MM_RESET_N=1
CONFIG_MM_WAKE=2
CONFIG_MM_BUSY=5
CONFIG_MM_SPI_SCK=7
CONFIG_MM_SPI_MOSI=9
CONFIG_MM_SPI_MISO=8
CONFIG_MM_SPI_CS=4
CONFIG_MM_SPI_IRQ=3
CONFIG_MM_BCF_FILE="bcf_fgh100mhaamd.mbin"
```
